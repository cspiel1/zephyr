## CMakeLists.txt
```
# SPDX-License-Identifier: Apache-2.0

cmake_minimum_required(VERSION 3.20.0)

find_package(Zephyr REQUIRED HINTS $ENV{ZEPHYR_BASE})
project(commend)

FILE(GLOB app_sources src/*.c)

target_sources(app PRIVATE ${app_sources})
```

## prj.conf
```kconfig
CONFIG_BUILD_OUTPUT_HEX=y
CONFIG_LOG=y
CONFIG_I2S=y
CONFIG_DMA_TCD_QUEUE_SIZE=8
CONFIG_I2C=y
CONFIG_GPIO=y

# Use i2c shell for manual commands towards the codec
CONFIG_SHELL=y
CONFIG_I2C_SHELL=y

#Print thread statistics periodically
CONFIG_QEMU_ICOUNT=n
CONFIG_THREAD_ANALYZER=y
CONFIG_THREAD_ANALYZER_USE_PRINTK=y
CONFIG_THREAD_ANALYZER_AUTO=y
CONFIG_THREAD_ANALYZER_AUTO_INTERVAL=20


#Just for experiments with libre
CONFIG_MBEDTLS=y
CONFIG_POSIX_MAX_FDS=4
CONFIG_POSIX_API=y
CONFIG_POSIX_CLOCK=y
CONFIG_EVENTFD=y
CONFIG_FNMATCH=y
CONFIG_GETOPT=y
```

## src/main.c
```c
/*
 * Copyright (c) 2022 Intel Corporation
 *
 * SPDX-License-Identifier: Apache-2.0
 */

#include <zephyr/device.h>
#include "wm8960.h"

#include <zephyr/drivers/i2s.h>
#include <zephyr/drivers/i2c.h>
#include <zephyr/kernel.h>

static struct rtio_wm8960 wm8960;

/*
static struct rtio_lis2mdl lis2mdl;
static struct rtio_lsm6dso lsm6dso;
*/


static struct i2s_config i2s_cfg;

#include <zephyr/logging/log.h>
LOG_MODULE_REGISTER(mosyn, LOG_LEVEL_DBG);

#define SAMPLE_NO 32

/* The data_l represent a sine wave */
static int16_t data_l[SAMPLE_NO] = {
	  6392,  12539,  18204,  23169,  27244,  30272,  32137,  32767,  32137,
	 30272,  27244,  23169,  18204,  12539,   6392,      0,  -6393, -12540,
	-18205, -23170, -27245, -30273, -32138, -32767, -32138, -30273, -27245,
	-23170, -18205, -12540,  -6393,     -1,
};

/* The data_r represent a sine wave with double the frequency of data_l */
static int16_t data_r[SAMPLE_NO] = {
	 12539,  23169,  30272,  32767,  30272,  23169,  12539,      0, -12540,
	-23170, -30273, -32767, -30273, -23170, -12540,     -1,  12539,  23169,
	 30272,  32767,  30272,  23169,  12539,      0, -12540, -23170, -30273,
	-32767, -30273, -23170, -12540,     -1,
};

#define FRAME_CLK_FREQ 44100
#define TIMEOUT 10
#define BLOCK_SIZE (2 * sizeof(data_l))
#define NUM_TX_BLOCKS 4


/**
 * Fill a block with predefined data (data_r, data_l)
 * with bit shift attenuation
 */
static void fill_buf(int16_t *tx_block, int att)
{
	for (int i = 0; i < SAMPLE_NO; i++) {
		tx_block[2 * i] = data_l[i] >> att;
		tx_block[2 * i + 1] = data_r[i] >> att;
	}
}

int main()
{
	LOG_INF("Commend Tests!\n");

	int ret;

	const struct device *i2s_dev = DEVICE_DT_GET(DT_NODELABEL(sai1));
	const struct device *i2c_dev = DEVICE_DT_GET(DT_NODELABEL(lpi2c5));

	__ASSERT(i2c_dev != NULL, "expected a valid i2c device");
	__ASSERT(i2s_dev != NULL, "expected a valid i2s device");

	wm8960_configure(&wm8960, i2c_dev, i2s_dev);

	int16_t tx_block[SAMPLE_NO];

	/* i2s_buf_write wants to copy, so setup a buf here then copy it in */
	for (int i = 0; i < NUM_TX_BLOCKS; i++) {
		LOG_INF("filling buf");
		fill_buf((uint16_t *)tx_block, 0);
		LOG_INF("writing buf");
		i2s_buf_write(i2s_dev, tx_block, sizeof(tx_block));
	}

	LOG_INF("trigging i2s");
	i2s_trigger(i2s_dev, I2S_DIR_TX, I2S_TRIGGER_START);

	while (true) {
	for (int i = 0; i < 256; i++) {
		fill_buf((uint16_t *)tx_block, 0);
		i2s_buf_write(i2s_dev, tx_block, sizeof(tx_block));
		if (ret < 0) {
			printk("Failed to write block %d: %d\n", i, ret);
			//return false;
		}

	}
	//LOG_INF("wrote 128 blocks to i2s");
	}
}
```

## src/wm8960.c
```c
#include "wm8960.h"
#include <zephyr/drivers/i2c.h>
#include <zephyr/drivers/i2s.h>
#include <zephyr/kernel.h>

static const uint8_t wm8960_init_seq1[][2] = {
	WM8960_PAIR(WM8960_RESET, 0),     /* Reset to defaults */
	WM8960_PAIR(WM8960_PWR1, 0x00FE), /* Everything on (vmid, vref, ain, adc, micb, digenb) */
	WM8960_PAIR(WM8960_PWR2, 0x01FF), /* Everything on (dac, spk, out3, pll) */
	WM8960_PAIR(WM8960_PWR3, 0x001F), /* Everything on (mixers/mics) */
	WM8960_PAIR(WM8960_IFACE2,0x0040), /* Slave mode, Word Length 16 bits, Format I2S */
	WM8960_PAIR(WM8960_LOUT1, 0x016f), /* 0dB */
	WM8960_PAIR(WM8960_ROUT1, 0x016f), /* 0dB */
	WM8960_PAIR(WM8960_LMIX, 0x0100), /* DAC routing */
	WM8960_PAIR(WM8960_RMIX, 0x0100), /* DAC routing */
	//WM8960_PAIR(WM8960_CTL2, 0x0004), /* Unmute ramp volume */
	WM8960_PAIR(WM8960_CTL1, 0x0000), /* Unmute */
	WM8960_PAIR(WM8960_CLASSD1, 0x00F7), /* enable class d */
	WM8960_PAIR(WM8960_IFACE1,0x0002),
	WM8960_PAIR(WM8960_ADCL, 0x01B8),
	WM8960_PAIR(WM8960_LIN, 0x0117),
	WM8960_PAIR(WM8960_ADCR, 0x0178),
	WM8960_PAIR(WM8960_RINL, 0x0117),
	WM8960_PAIR(WM8960_ACTL1, 0x00C0),
	WM8960_PAIR(WM8960_ACTL4, 0x0040),
	WM8960_PAIR(WM8960_BYPASS1, 0x0000),
	WM8960_PAIR(WM8960_BYPASS2, 0x0000),
	WM8960_PAIR(WM8960_LADC, 0x01ff),
	WM8960_PAIR(WM8960_RADC, 0x01ff),
	//WM8960_PAIR(WM8960_LOUT2, 0x01FF),
	//WM8960_PAIR(WM8960_ROUT2, 0x01FF),
	//WM8960_PAIR(WM8960_CLOCK1, 0x01B0)
	WM8960_PAIR(WM8960_CLOCK1, 0x00D8),
	WM8960_PAIR(WM8960_LOUT2, 0x0100),
	WM8960_PAIR(WM8960_ROUT2, 0x0100)
};
K_MEM_SLAB_DEFINE(tx_mem_slab, 128, 4, 32);

/**
 * Sets up the WM8960 as a RTIO IODEV
 *
 * With a DAC input and Headphone Output
 */
void wm8960_configure(struct rtio_wm8960 *wm8960,
		      const struct device *i2c,
		      const struct device *i2s)
{
	int ret;

	wm8960->i2c = i2c;
	wm8960->i2s = i2s;

	printk("info name: %s\n", i2c->name);

	for(int i = 0; i < ARRAY_SIZE(wm8960_init_seq1); i++) {
		ret = i2c_reg_write_byte(wm8960->i2c, WM8960_ADDR, wm8960_init_seq1[i][0], wm8960_init_seq1[i][1]);
		printk("seq: %hhx, %hhx\n", wm8960_init_seq1[i][0], wm8960_init_seq1[i][1]);
		if (ret < 0) {
			printk("Initialization step %d failed with error %d\n", i, ret);
		}
		__ASSERT(ret == 0, "Failed to write out wm8960 init sequence");
	}

	

	struct i2s_config i2s_cfg;

	i2s_cfg.word_size = 16U;
	i2s_cfg.channels = 2U;
	i2s_cfg.format = I2S_FMT_DATA_FORMAT_I2S;
	i2s_cfg.frame_clk_freq = 44100;
	i2s_cfg.block_size = 128;
	i2s_cfg.timeout = 1000;
	i2s_cfg.options = I2S_OPT_FRAME_CLK_MASTER | I2S_OPT_BIT_CLK_MASTER;
	i2s_cfg.mem_slab = &tx_mem_slab;

	ret = i2s_configure(wm8960->i2s, I2S_DIR_TX, &i2s_cfg);

	struct i2s_config* i2s_cfg1 = i2s_config_get(wm8960->i2s, I2S_DIR_TX);

	printk("word_size %d\n", i2s_cfg1->word_size);
	printk("channels %d\n", i2s_cfg1->channels);
	printk("frame_clk_freq %d\n", i2s_cfg1->frame_clk_freq);
	printk("block_size %d\n", i2s_cfg1->block_size);
	printk("timeout %d\n", i2s_cfg1->timeout);
}
```
